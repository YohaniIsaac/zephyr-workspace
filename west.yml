## west.yml
```yaml
manifest:
  projects:
    - name: zephyr
      url: https://github.com/zephyrproject-rtos/zephyr
      revision: v4.3.0
      import:
        path-prefix: deps
        # now we just fetch used modules.
        # name-allowlist:
        #   - picolibc
        #   - hal_atmel
        #   - cmsis
        #   - loramac-node
      path: zephyr
      # This line enables extra `west` commands such as `west build`.
      west-commands: scripts/west-commands.yml

  self:
    path: .
```
